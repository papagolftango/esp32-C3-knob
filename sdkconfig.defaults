## sdkconfig.defaults
```kconfig
# ESP-IDF Configuration for ESP32-S3-Knob-Touch-LCD-1.8

# ESP32-S3 Configuration
CONFIG_IDF_TARGET_ESP32S3=y
CONFIG_ESP32S3_DEFAULT_CPU_FREQ_240=y

# Memory Configuration
CONFIG_ESP32S3_SPIRAM_SUPPORT=y
CONFIG_SPIRAM=y
CONFIG_SPIRAM_MODE_OCT=y
CONFIG_SPIRAM_SPEED_80M=y

# FreeRTOS Configuration
CONFIG_FREERTOS_HZ=1000

# LVGL Configuration
CONFIG_LV_COLOR_DEPTH_16=y
CONFIG_LV_COLOR_16_SWAP=n
CONFIG_LV_MEM_CUSTOM=n
CONFIG_LV_MEM_SIZE=65536
CONFIG_LV_FONT_MONTSERRAT_14=y
CONFIG_LV_FONT_MONTSERRAT_16=y
CONFIG_LV_FONT_MONTSERRAT_18=y
CONFIG_LV_USE_ARC=y
CONFIG_LV_USE_LABEL=y

# WiFi Configuration
CONFIG_ESP_WIFI_AUTH_OPEN=y
CONFIG_ESP_WIFI_AUTH_WEP=y
CONFIG_ESP_WIFI_AUTH_WPA_PSK=y
CONFIG_ESP_WIFI_AUTH_WPA2_PSK=y

# Component Configuration
CONFIG_ESP_SYSTEM_EVENT_QUEUE_SIZE=32
CONFIG_ESP_SYSTEM_EVENT_TASK_STACK_SIZE=4096

# SPI Configuration
CONFIG_SPI_MASTER_IN_IRAM=y
CONFIG_SPI_MASTER_ISR_IN_IRAM=y

# GPIO Configuration
CONFIG_GPIO_ESP32_SUPPORT_SWITCH_SLP_PULL=y
```
